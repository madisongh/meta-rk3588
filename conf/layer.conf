## conf/layer.conf
```bitbake
# SPDX-License-Identifier: MIT
BBPATH .= ":${LAYERDIR}"
BBFILES += "${LAYERDIR}/recipes-*/*/*.bb \
	    ${LAYERDIR}/recipes-*/*/*.bbappend"

BBFILE_COLLECTIONS += "rk3588"
BBFILE_PATTERN_rk3588 := "^${LAYERDIR}/"
BBFILE_PRIORITY_rk3588 = "5"

# openembedded-layer required for v4l-utils, opencv
LAYERDEPENDS_rk3588 = "core openembedded-layer"

LAYERVERSION_rk3588 = "1"
LAYERSERIES_COMPAT_rk3588 = "kirkstone"
```

## conf/machine/em3566.conf
```bitbake
# Copyright (c) 2023, M. Madison
# SPDX-License-Identifier: MIT

#@TYPE: Machine
#@NAME: Boardcon EM3566 dev kit
#@DESCRIPTION: EM3566 dev kit for the CM3566 module

require conf/machine/include/rk3566-common.inc

KERNEL_DEVICETREE = "rockchip/rk3566-em3566-linux.dtb"

MACHINE_FEATURES += "bluetooth wifi"

RK_KERNEL_BOOTARGS ?= "root=/dev/mmcblk0p3 rootwait rootfstype=ext4"
WKS_FILE ?= "rk35xx-emmc.wks"
```

## conf/machine/include/rk3566-common.inc
```bitbake
# Copyright (c) 2023, M. Madison
# SPDX-License-Identifier: MIT
SOC_FAMILY = "rk3568"
require conf/machine/include/soc-family.inc
DEFAULTTUNE ?= "armv8a-crc"
require conf/machine/include/arm/armv8-2a/tune-cortexa55.inc
require conf/machine/include/rockchip-common.inc

UBOOT_MACHINE ?= "rk3566_defconfig"
SERIAL_CONSOLES ?= "1500000;ttyFIQ0"

RK_TARGET_SOC = "rk356x"

MALI_GPU = "bifrost-g52"
MALI_VERSION = "g2p0"
```

## conf/machine/include/rk3588-common.inc
```bitbake
# Copyright (c) 2023, M. Madison
# SPDX-License-Identifier: MIT
SOC_FAMILY = "rk3588"
require conf/machine/include/soc-family.inc
DEFAULTTUNE ?= "armv8a-crc"
require conf/machine/include/arm/armv8-2a/tune-cortexa76-cortexa55.inc
require conf/machine/include/rockchip-common.inc

UBOOT_MACHINE ?= "rk3588_defconfig"
UBOOT_ENTRYPOINT = "0x00400000"
UBOOT_RD_LOADADDRESS = "0x0a200000"
UBOOT_DTB_LOADADDRESS = "0xa100000"
SERIAL_CONSOLES ?= "1500000;ttyFIQ0"

RK_TARGET_SOC = "rk3588"

MALI_GPU = "valhall-g610"
MALI_VERSION = "g13p0"
```

## conf/machine/include/rockchip-common.inc
```bitbake
# Copyright (c) 2023, M. Madison
# SPDX-License-Identifier: MIT
MACHINEOVERRIDES =. "rockchip:"
SOC_FAMILY_PKGARCH = "${ARMPKGARCH}${ARMPKGSFX_DSP}${ARMPKGSFX_EABI}${ARMPKGSFX_ENDIAN}${ARMPKGSFX_FPU}_${SOC_FAMILY}"
RK_PKGARCH = "${ARMPKGARCH}${ARMPKGSFX_DSP}${ARMPKGSFX_EABI}${ARMPKGSFX_ENDIAN}${ARMPKGSFX_FPU}_rockchip"
PACKAGE_EXTRA_ARCHS:append = " ${RK_PKGARCH} ${SOC_FAMILY_PKGARCH}"

KERNEL_IMAGETYPES ?= "Image"
KERNEL_IMAGETYPE ?= "Image"

IMAGE_BOOT_FILES = "${KERNEL_IMAGETYPE} ${@' '.join([os.path.basename(f) + ';rockchip/' + os.path.basename(f) for f in d.getVar('KERNEL_DEVICETREE').split()])}"
IMAGE_FSTYPES ?= "ext4 wic wic.bmap"
WIC_DEPLOY_EXTRA_DEPS ?= "virtual/bootloader:do_deploy"
do_image_wic[depends] += "${WIC_DEPLOY_EXTRA_DEPS}"

MACHINE_ESSENTIAL_EXTRA_RDEPENDS = "${@'rockchip-udev-rules' if d.getVar('VIRTUAL-RUNTIME_dev_manager') in ['udev', 'systemd'] else ''}"

PREFERRED_PROVIDER_virtual/kernel ?= "linux-rockchip-downstream"
PREFERRED_PROVIDER_virtual/bootloader ?= "u-boot-rockchip-downstream"
PREFERRED_PROVIDER_u-boot ?= "u-boot-rockchip-downstream"

PREFERRED_PROVIDER_virtual/xserver ?= "xserver-xorg-rockchip"
PREFERRED_PROVIDER_virtual/xserver-xf86 ?= "xserver-xorg-rockchip"
PREFERRED_PROVIDER_xserver-xorg ?= "xserver-xorg-rockchip"
XSERVER ?= "xserver-xorg-rockchip \
            xf86-video-modesetting \
            xserver-xorg-rockchip-module-exa \
            ${@bb.utils.contains('DISTRO_FEATURES', 'opengl', 'xserver-xorg-rockchip-extension-glx', '', d)}"

PREFERRED_PROVIDER_virtual/egl ?= "rockchip-libmali"
PREFERRED_PROVIDER_virtual/libgles1 ?= "rockchip-libmali"
PREFERRED_PROVIDER_virtual/libgles2 ?= "rockchip-libmali"
PREFERRED_PROVIDER_virtual/libgles3 ?= "rockchip-libmali"
PREFERRED_PROVIDER_virtual/libopencl ?= "rockchip-libmali"
PREFERRED_PROVIDER_virtual/libgbm ?= "rockchip-libmali"
PREFERRED_PROVIDER_virtual/libgl ?= "mesa-gl"
PREFERRED_PROVIDER_virtual/mesa ?= "mesa-gl"

# XXX Work around libforms directly depending on mesa rather than virtual/libgl
COMPATIBLE_MACHINE:pn-libforms:rockchip = "(-)"
```

## conf/machine/orangepi5.conf
```bitbake
# Copyright (c) 2023, M. Madison
# SPDX-License-Identifier: MIT

#@TYPE: Machine
#@NAME: Orange Pi 5
#@DESCRIPTION: Orange Pi 5 SBC based on Rockchip RK3588S

require conf/machine/include/rk3588-common.inc

KERNEL_DEVICETREE = "rockchip/rk3588s-orangepi-5.dtb"

PREFERRED_PROVIDER_virtual/kernel = "linux-orangepi"
PREFERRED_PROVIDER_virtual/bootloader = "u-boot-orangepi"
PREFERRED_PROVIDER_u-boot = "u-boot-orangepi"

UBOOT_MACHINE = "orangepi_5_defconfig"

RK_KERNEL_BOOTARGS ?= "root=/dev/mmcblk1p3 rootwait rootfstype=ext4"
WKS_FILE ?= "rk35xx-sdcard.wks"
```

## wic/opi5-sdcard.wks
```
bootloader --ptable gpt --configfile="opi5-extlinux.conf"

part --source rawcopy --sourceparams="file=idblock.img" --offset 64s --no-table
part --source rawcopy --sourceparams="file=uboot.img" --offset 16384s --no-table
part /boot --source bootimg-partition --sourceparams="loader=u-boot" --ondisk mmcblk1 --fstype=vfat --label boot --active --offset 32768s
part / --source rootfs --ondisk mmcblk1 --fstype ext4 --part-name rootfs --offset 261244s
```

## wic/rk35xx-emmc.wks
```
bootloader --ptable gpt

part --source rawcopy --sourceparams="file=idblock.img" --offset 64s --no-table
part --source rawcopy --sourceparams="file=idblock.img" --offset 1088s --no-table
part --source rawcopy --sourceparams="file=uboot.img" --offset 16384s --no-table
part --source rawcopy --sourceparams="file=fitImage" --part-name boot --active --offset 32768s --fixed-size=64M
part --part-name security --fixed-size=4M
part / --source rootfs --ondisk mmcblk0 --fstype ext4 --part-name rootfs --label rootfs --offset 261244s
```
