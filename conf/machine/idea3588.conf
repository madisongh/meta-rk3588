## conf/machine/idea3588.conf
```bitbake
# SPDX-License-Identifier: MIT

#@TYPE: Machine
#@NAME: Boardcon Idea3588 dev kit
#@DESCRIPTION: Idea3588 dev kit for the CM3588 module

require conf/machine/include/rk3588-common.inc

KERNEL_DEVICETREE = "rockchip/Boardcon-Idea3588-V4-V2.0.dtb"

MACHINE_FEATURES += "bluetooth wifi alsa"

RK_KERNEL_BOOTARGS ?= "root=/dev/mmcblk0p4 rootwait rootfstype=ext4"
WKS_FILE ?= "rk35xx-emmc.wks"
```
